## factorytest/Kconfig
```kconfig
menu "Factory test"

    config FACTORY_TEST_MODE
        bool "Enable factory test firmware (interactive REPL)"
        default n
        help
            编译并运行工厂测试固件。关闭后 main.c 的 app_main 为空，
            测试入口不会被调用；组件仍参与构建，链接器会丢弃未引用代码。

    if FACTORY_TEST_MODE

        config FT_LCD_WIDTH
            int "LCD width"
            range 80 480
            default 240

        config FT_LCD_HEIGHT
            int "LCD height"
            range 80 480
            default 284

        config FT_LCD_X_OFFSET
            int "LCD X offset"
            default 0

        config FT_LCD_Y_OFFSET
            int "LCD Y offset"
            default 0

        config FT_LCD_SPI_MHZ
            int "LCD SPI clock (MHz)"
            range 10 80
            default 40

        config FT_LCD_MAX_BRIGHTNESS
            int "Default backlight (%)"
            range 0 100
            default 70

        config FT_ECHO_GAIN_X10
            int "Audio echo gain x10"
            range 1 20
            default 8
            help
                麦克风回显增益，单位 0.1（8 = x0.8）。过大会产生啸叫。

    endif

endmenu
```

## main/Kconfig.projbuild
```kconfig
menu "WatchShell"

    config WATCH_WIFI_SSID
        string "Default Wi-Fi SSID"
        default ""
        help
            留空则首次启动进入 ESP-Watch 配置热点，用网页填写 Wi-Fi 和云端地址。

    config WATCH_WIFI_PASSWORD
        string "Default Wi-Fi password"
        default ""

    config WATCH_AI_URL
        string "Default AI WebSocket URL"
        default ""
        help
            ws:// 或 wss:// 地址。自建 xiaozhi-esp32-server 时填写其 WebSocket 端点。

    config WATCH_AI_TOKEN
        string "Default AI access token"
        default ""

    config WATCH_VIDEO_URL
        string "Default video catalog URL"
        default ""
        help
            返回 {"items":[...]} 的 HTTP(S) URL，例如
            http://192.168.1.10:8080/watch/api/v1/videos

    config WATCH_VIDEO_TOKEN
        string "Default video catalog token"
        default ""

    config WATCH_MUSIC_URL
        string "Default music catalog URL"
        default ""
        help
            返回 {"items":[...]} 的 HTTP(S) URL，例如
            http://192.168.1.10:8080/watch/api/v1/music

    config WATCH_MUSIC_TOKEN
        string "Default music catalog token"
        default ""

    config WATCH_AP_SSID
        string "Configuration AP SSID"
        default "ESP-Watch"

    config WATCH_AP_PASSWORD
        string "Configuration AP password"
        default "watchshell"

    config WATCH_LCD_SPI_MHZ
        int "LCD SPI clock (MHz)"
        range 10 80
        default 40

    config WATCH_BRIGHTNESS
        int "Default brightness (%)"
        range 5 100
        default 75

    config WATCH_AUDIO_VOLUME
        int "Default audio volume (%)"
        range 0 100
        default 60

    config WATCH_NORMAL_SPLASH_MS
        int "Splash duration after a user-requested power-off (ms)"
        range 0 2000
        default 450

    config WATCH_FAST_SPLASH_MS
        int "Splash duration after an idle power-off (ms)"
        range 0 500
        default 60

    config WATCH_IDLE_POWEROFF_SEC
        int "Idle auto power-off timeout (seconds, 0 = disabled)"
        range 0 3600
        default 120

    config WATCH_IDLE_OFF_WHILE_CHARGING
        bool "Allow idle power-off while VBUS is present"
        default n

    config WATCH_LOW_BATT_MV
        int "Low battery warning threshold (mV)"
        range 3000 3800
        default 3400

    config WATCH_LOW_BATT_RECOVER_MV
        int "Low battery warning recovery threshold (mV)"
        range 3000 4200
        default 3550

    config WATCH_LOW_BATT_WARN_SEC
        int "Low battery warning time before power-off (seconds)"
        range 1 60
        default 3

endmenu
```

## sdkconfig.defaults
```kconfig
CONFIG_IDF_TARGET="esp32s3"

# 板载 W25Q128 (16 MB) + ESP32-S3R8 片内 8 MB 八线 PSRAM
CONFIG_ESPTOOLPY_FLASHSIZE_16MB=y
CONFIG_SPIRAM=y
CONFIG_SPIRAM_MODE_OCT=y
CONFIG_SPIRAM_SPEED_80M=y

# WatchShell + FAT 存储分区
CONFIG_PARTITION_TABLE_CUSTOM=y
CONFIG_PARTITION_TABLE_CUSTOM_FILENAME="partitions.csv"

# 主控制台：USB-Serial-JTAG（GPIO19/20 -> CH334P 下行口 2）
CONFIG_ESP_CONSOLE_USB_SERIAL_JTAG=y

# 文件系统 / HTTP / TLS
CONFIG_FATFS_LFN_HEAP=y
CONFIG_FATFS_MAX_LFN=255
CONFIG_HTTPD_MAX_REQ_HDR_LEN=2048
CONFIG_HTTPD_MAX_URI_LEN=512
CONFIG_MBEDTLS_CERTIFICATE_BUNDLE=y
CONFIG_MBEDTLS_CERTIFICATE_BUNDLE_DEFAULT_CMN=y

# 主任务 / 事件任务余量
CONFIG_ESP_MAIN_TASK_STACK_SIZE=8192
CONFIG_ESP_SYSTEM_EVENT_TASK_STACK_SIZE=4096
CONFIG_FREERTOS_HZ=1000

# 工厂测试需要 BLE；WatchShell 不使用 BLE，但保留组件以便随时切回
CONFIG_BT_ENABLED=y
CONFIG_BT_NIMBLE_ENABLED=y
CONFIG_BT_NIMBLE_ROLE_CENTRAL=y
CONFIG_BT_NIMBLE_ROLE_OBSERVER=y
CONFIG_BT_NIMBLE_ROLE_PERIPHERAL=y
CONFIG_BT_NIMBLE_ROLE_BROADCASTER=y
CONFIG_BT_NIMBLE_MAX_CONNECTIONS=1

# 可选的默认配置（也可以启动后在网页/串口里改）
CONFIG_WATCH_WIFI_SSID=""
CONFIG_WATCH_WIFI_PASSWORD=""
CONFIG_WATCH_AI_URL=""
CONFIG_WATCH_AI_TOKEN=""
CONFIG_WATCH_VIDEO_URL=""
CONFIG_WATCH_VIDEO_TOKEN=""
CONFIG_WATCH_AP_SSID="ESP-Watch"
CONFIG_WATCH_AP_PASSWORD="watchshell"

# Power / startup behavior
CONFIG_WATCH_NORMAL_SPLASH_MS=450
CONFIG_WATCH_FAST_SPLASH_MS=60
CONFIG_WATCH_IDLE_POWEROFF_SEC=120
# CONFIG_WATCH_IDLE_OFF_WHILE_CHARGING is not set
CONFIG_WATCH_LOW_BATT_MV=3400
CONFIG_WATCH_LOW_BATT_RECOVER_MV=3550
CONFIG_WATCH_LOW_BATT_WARN_SEC=3
```
